// i use uint8_t instead of int in various places throughout this script. This is just to save some ram, since an int takes two whereas a uint8_t takes only one byte
// this really only matters with the buffer list, where there's 432 uint8_t

#include <FastLED.h>
#include <EEPROM.h>

// number of LEDs on the led matrix. I can't gurantee it to work with values other than 144
#define NUM_LEDS 144

// data pin of the led matrix
#define DATA_PIN 14

// "round" small and high color values
#define ROUND 8

// List of R,G and B values for 144 LED stored in the program flash
// These should have NUM_LEDS * 3 entries (rgb for each led), otherwise expect random values
const uint8_t l0[] PROGMEM = {0,0,0,25,25,25,79,79,79,24,25,25,12,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0,0};
const uint8_t l1[] PROGMEM = {0,0,0,25,25,25,79,79,79,24,25,25,12,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0,0};
const uint8_t l2[] PROGMEM = {0,0,0,25,25,25,79,79,79,24,25,25,12,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0,0};
const uint8_t l3[] PROGMEM = {0,0,0,25,25,25,79,79,79,24,25,25,12,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0,0};
const uint8_t l4[] PROGMEM = {0,0,0,25,25,25,79,79,79,24,25,25,12,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0,0};
const uint8_t l5[] PROGMEM = {0,0,0,25,25,25,79,79,79,24,25,25,12,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0,0};
const uint8_t l6[] PROGMEM = {0,0,0,25,25,25,79,79,79,24,25,25,12,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0,0};

// the pins of the image selection switches (2 to the power of x)
// there is an internal Pullup Resistor, so these pins are active low!!
#define INPUT_2_0 1
#define INPUT_2_1 2
#define INPUT_2_2 3

// a global list of CRGB values per LED -> could be local?? would FastLED init have to local then?
// -> no need to be local for now, there's enough ram left over
CRGB leds[NUM_LEDS];

// a global "buffer" array for 3 rgb values per LED 
// it has to be global since its impossible to return an array (thanks to static memory allocation)
uint8_t tempList[NUM_LEDS*3];

// A global variable for the last state of the inputs
// if set to an invalid state (more than 7), a updateImage is called in the next loop
uint8_t previousInput = 8;

void setup() { 
    FastLED.addLeds<WS2812, DATA_PIN, RGB>(leds, NUM_LEDS);
    FastLED.clear();

    Serial.begin(115200);

    pinMode(INPUT_2_0, INPUT_PULLUP);
    pinMode(INPUT_2_1, INPUT_PULLUP);
    pinMode(INPUT_2_2, INPUT_PULLUP);
}

void loop() { 
    
    // if serial data is available
    if(Serial.available() > 0){
        // if tempList was successfully updated, write the new list to the eeprom
        if(readSerial()){
            // write tempList to eeprom
            // tempList is 432 bytes big, so there would be enough EEPROM space for another (1024 bytes) 
            for(int i = 0; i < NUM_LEDS*3; i++){
                EEPROM.update(i, tempList[i]);
            }
            // force a reload later in the loop
            previousInput = 8;
        }
    }

    uint8_t input = readInputs();
    // if input has changed since the last loop then update the image
    if(previousInput != input){
        updateImage(input);
    }
    previousInput = input;

}

bool readSerial(){

    // if the first char is the start char 'S'
    if(Serial.read() == 'S'){
        // a buffer to store incoming digits of a number
        char bufferArray[3] = {'q', 'q', 'q'};

        // Get the realtive time at the start of the while loop
        uint32_t startTime = millis();

        // These are two independent counters
        // iByte gets incremented when a digit is read and is reset when a complete value has been read (at a comma)
        // iVal gets incremented when a value is added to tempList and is not reset
        int iByte = 0;
        int iVal = 0;

        while(true){
            char thisLoop = Serial.read();

            if(isDigit(thisLoop)){
                bufferArray[iByte] = thisLoop;

                iByte++;
            }
            // if this char is a comma, then reset iByte to 0, convert the bufferArray to an int
            // and write this int to tempList[iVal], after that iVal gets incremented
            if(thisLoop == ','){
                
                tempList[iVal] = bufferArrayToInt(bufferArray);

                // reset the bufferArray to make room for a new number
                bufferArray[0] = 'q';
                bufferArray[1] = 'q';
                bufferArray[2] = 'q';

                iVal++;
                iByte = 0;
            }
            // if the end char 'E' is read, terminate the loop
            if(thisLoop == 'E'){
                return true;
            }
            // timeout after 3 seconds
            if(millis() - startTime > 3000){
                return false;
            }
        }
    }
    return false;
}

void updateImage(uint8_t input){

    // input 7 is the image via Serial stored in the EEPROM
    if(input == 7){
        // read list from eeprom into tempList
        for(int i = 0; i < NUM_LEDS*3; i++){
            tempList[i] = EEPROM.read(i);
        }
    }
    // input 0 to 6 are the hardcoded images
    else if(input >= 0 && input <= 6){
        // get one of the hardcoded lists
        getHardcodedList(input);

    }else{
        // input is invalid, terminate the function
        return;
    }

    // then write the updated tempList to leds
    writeTempListToLeds();
}

uint8_t readInputs(){

    // digitalRead returns 0 for LOW and 1 for HIGH
    uint8_t in0 = digitalRead(INPUT_2_0);
    uint8_t in1 = digitalRead(INPUT_2_1);
    uint8_t in2 = digitalRead(INPUT_2_2);

    // to convert this "binary number" into base then, multiply each bit by the corresponding power of 2
    uint8_t input = in0 * 1 + in1 * 2 + in2 * 4; 
    
    // if the pins are not connected, input will be 7 due to INTERNAL_PULLUP
    return input;
}

void writeTempListToLeds(){ 

    // The for loop is executed once for every pixel, and the R,G and B values of the pixel are written to the corresponding LED 
    // in the leds array by having a simultaneous counter that increments in steps of 1 instead of 3 (as i3)
    int i = 0;
    for(int i3 = 0; i3 < NUM_LEDS*3; i3 += 3){
      
        // This might have to be adjusted this if the colors seem wrong
        uint8_t G = tempList[i3];
        uint8_t R = tempList[i3 + 1];
        uint8_t B = tempList[i3 + 2];
        leds[i].setRGB(R, G, B);

        i++;
    }
    FastLED.show();
}

bool getHardcodedList(uint8_t number){
    
    // number has to be between 0 and 6
    switch(number){
        case 0:
            for(int i = 0; i < NUM_LEDS*3; i++){
                tempList[i] = pgm_read_byte(&l0[i]);
            }
            break;
        case 1:
            for(int i = 0; i < NUM_LEDS*3; i++){
                tempList[i] = pgm_read_byte(&l1[i]);
            }
            break;
        case 2:
            for(int i = 0; i < NUM_LEDS*3; i++){
                tempList[i] = pgm_read_byte(&l2[i]);
            }
            break;
        case 3:
            for(int i = 0; i < NUM_LEDS*3; i++){
                tempList[i] = pgm_read_byte(&l3[i]);
            }
            break;
        case 4:
            for(int i = 0; i < NUM_LEDS*3; i++){
                tempList[i] = pgm_read_byte(&l4[i]);
            }
            break;
        case 5:
            for(int i = 0; i < NUM_LEDS*3; i++){
                tempList[i] = pgm_read_byte(&l5[i]);
            }
            break;
        case 6:
            for(int i = 0; i < NUM_LEDS*3; i++){
                tempList[i] = pgm_read_byte(&l6[i]);
            }
            break;
        default:
            return false;
    }
    return true; 
}

uint8_t bufferArrayToInt(char bufferArray[3]){
    // returns the value of an array with 3 ASCII digits (if less digits the char has to be 'q')

    uint8_t bufferValue = 0;

    if(bufferArray[0]=='q' && bufferArray[1]=='q' && bufferArray[2]=='q'){ // 0 digits
        // if this occurs, then there was a problem with the serial communication
        // i might remove this if statement
    }
    else if(bufferArray[1]=='q' && bufferArray[2]=='q'){ // 1 digit
        // this is some bit magic that converts ASCII numbers to numbers
        bufferValue = (bufferArray[0] & 0xf);
    }
    else if(bufferArray[2]=='q'){ // 2 digits
        bufferValue = (bufferArray[0] & 0xf) *10;
        bufferValue += (bufferArray[1] & 0xf);
    }
    else{ // 3 digits
        bufferValue = (bufferArray[0] & 0xf) *100;
        bufferValue += (bufferArray[1] & 0xf) *10;
        bufferValue += (bufferArray[2] & 0xf);
    }

    // "round" high and low values to reduce EEPROM writes and dimly light LEDs 
    if(bufferValue > 255 - ROUND){
        bufferValue = 255;
    }
    if(bufferValue < 0 + ROUND){
        bufferValue = 0;
    }
    return bufferValue;
}



